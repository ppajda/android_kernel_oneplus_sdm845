## drivers/oneplus/Kconfig
```kconfig
source "drivers/oneplus/coretech/Kconfig"
source "drivers/oneplus/drivers/Kconfig"
```

## drivers/oneplus/coretech/Kconfig
```kconfig
config HOUSTON
	default n
	bool "houston rocket play your temperature guard"
	help
	 Realtime temperature monitor
```

## drivers/oneplus/drivers/Kconfig
```kconfig
config OEM_DEBUG_SUPPORT
        default y
        bool

config PARAM_READ_WRITE
	bool "Param partition read/write support"
	default y
	help
		if you want to read/write the param partition in kernel,
		then you must say Y here.

source "drivers/oneplus/drivers/input/fingerprint/Kconfig"
```
